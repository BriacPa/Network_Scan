#include <Wire.h>
#include <U8g2lib.h>
#include <WiFi.h>
#include <esp_wifi.h>
#include <vector>
#include <set>

// Define the I2C SDA and SCL pins for ESP32
#define SDA_PIN 21
#define SCL_PIN 22

// Initialize the display: SH1106 128x64 OLED I2C
U8G2_SH1106_128X64_NONAME_F_HW_I2C display(U8G2_R0, SDA_PIN, SCL_PIN);

// frames

// Animation 
// 'frame_0_delay-0', 128x64px
const unsigned char My_bitmapframe_0_delay_0[] PROGMEM = {
	0x00, 0x00, 0x00, 0x00, 0x00, 0x00, 0x00, 0x00, 0x00, 0x00, 0x00, 0x00, 0x00, 0x00, 0x00, 0x00, 
	0x00, 0x00, 0x00, 0x00, 0x00, 0x00, 0x00, 0x00, 0x00, 0x00, 0x00, 0x00, 0x00, 0x00, 0x00, 0x00, 
	0x00, 0x00, 0x00, 0x00, 0x00, 0x00, 0x00, 0x00, 0x00, 0x00, 0x00, 0x00, 0x00, 0x00, 0x00, 0x00, 
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	0x00, 0x00, 0x00, 0x00, 0x00, 0x00, 0x00, 0x00, 0x00, 0x00, 0x00, 0x00, 0x00, 0x00, 0x00, 0x00
};
// 'frame_1_delay-0', 128x64px
const unsigned char My_bitmapframe_1_delay_0[] PROGMEM = {
	0x00, 0x00, 0x00, 0x00, 0x00, 0x00, 0x00, 0x00, 0x00, 0x00, 0x00, 0x00, 0x00, 0x00, 0x00, 0x00, 
	0x00, 0x00, 0x00, 0x00, 0x00, 0x00, 0x00, 0x00, 0x00, 0x00, 0x00, 0x00, 0x00, 0x00, 0x00, 0x00, 
	0x00, 0x00, 0x00, 0x00, 0x00, 0x00, 0x00, 0x00, 0x00, 0x00, 0x00, 0x00, 0x00, 0x00, 0x00, 0x00, 
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	0x00, 0x00, 0x00, 0x00, 0x00, 0x00, 0x00, 0x00, 0x00, 0x00, 0x00, 0x00, 0x00, 0x00, 0x00, 0x00
};
// 'frame_2_delay-0', 128x64px
const unsigned char My_bitmapframe_2_delay_0[] PROGMEM = {
	0x00, 0x00, 0x00, 0x00, 0x00, 0x00, 0x00, 0x00, 0x00, 0x00, 0x00, 0x00, 0x00, 0x00, 0x00, 0x00, 
	0x00, 0x00, 0x00, 0x00, 0x00, 0x00, 0x00, 0x20, 0x00, 0x00, 0x00, 0x00, 0x00, 0x00, 0x00, 0x00, 
	0x00, 0x00, 0x00, 0x00, 0x00, 0x00, 0x00, 0xf0, 0x03, 0x00, 0x00, 0x00, 0x00, 0x00, 0x00, 0x00, 
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	0x00, 0x00, 0x00, 0x00, 0x00, 0x00, 0x00, 0x00, 0x00, 0x00, 0x00, 0x00, 0x00, 0x00, 0x00, 0x00
};
// 'frame_3_delay-0', 128x64px
const unsigned char My_bitmapframe_3_delay_0[] PROGMEM = {
	0x00, 0x00, 0x00, 0x00, 0x00, 0x00, 0x00, 0x00, 0x00, 0x00, 0x00, 0x00, 0x00, 0x00, 0x00, 0x00, 
	0x00, 0x00, 0x00, 0x00, 0x00, 0x00, 0x00, 0x00, 0x00, 0x00, 0x00, 0x00, 0x00, 0x00, 0x00, 0x00, 
	0x00, 0x00, 0x00, 0x00, 0x00, 0x00, 0x00, 0x00, 0x00, 0x00, 0x00, 0x00, 0x00, 0x00, 0x00, 0x00, 
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	0x00, 0x00, 0x00, 0x00, 0x00, 0x00, 0x00, 0x00, 0x00, 0x00, 0x00, 0x00, 0x00, 0x00, 0x00, 0x00
};
// 'frame_4_delay-0', 128x64px
const unsigned char My_bitmapframe_4_delay_0[] PROGMEM = {
	0x00, 0x00, 0x00, 0x00, 0x00, 0x00, 0x00, 0x00, 0x00, 0x00, 0x00, 0x00, 0x00, 0x00, 0x00, 0x00, 
	0x00, 0x00, 0x00, 0x00, 0x00, 0x00, 0x00, 0x00, 0x00, 0x00, 0x00, 0x00, 0x00, 0x00, 0x00, 0x00, 
	0x00, 0x00, 0x00, 0x00, 0x00, 0x00, 0x00, 0x00, 0x00, 0x00, 0x00, 0x00, 0x00, 0x00, 0x00, 0x00, 
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	0x00, 0x00, 0x00, 0x00, 0x00, 0x00, 0x00, 0x00, 0x00, 0x00, 0x00, 0x00, 0x00, 0x00, 0x00, 0x00
};
// 'frame_5_delay-0', 128x64px
const unsigned char My_bitmapframe_5_delay_0[] PROGMEM = {
	0x00, 0x00, 0x00, 0x00, 0x00, 0x00, 0x00, 0x00, 0x00, 0x00, 0x00, 0x00, 0x00, 0x00, 0x00, 0x00, 
	0x00, 0x00, 0x00, 0x00, 0x00, 0x00, 0x00, 0x00, 0x00, 0x00, 0x00, 0x00, 0x00, 0x00, 0x00, 0x00, 
	0x00, 0x00, 0x00, 0x00, 0x00, 0x00, 0x00, 0x00, 0x00, 0x00, 0x00, 0x00, 0x00, 0x00, 0x00, 0x00, 
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	0x00, 0x00, 0x00, 0x00, 0x00, 0x00, 0x00, 0x00, 0x00, 0x00, 0x00, 0x00, 0x00, 0x00, 0x00, 0x00
};
// 'frame_6_delay-0', 128x64px
const unsigned char My_bitmapframe_6_delay_0[] PROGMEM = {
	0x00, 0x00, 0x00, 0x00, 0x00, 0x00, 0x00, 0x00, 0x00, 0x00, 0x00, 0x00, 0x00, 0x00, 0x00, 0x00, 
	0x00, 0x00, 0x00, 0x00, 0x00, 0x00, 0x00, 0x00, 0x30, 0x00, 0x00, 0x00, 0x00, 0x00, 0x00, 0x00, 
	0x00, 0x00, 0x00, 0x00, 0x00, 0x00, 0x00, 0x00, 0x7e, 0x00, 0x00, 0x00, 0x00, 0x00, 0x00, 0x00, 
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	0x00, 0x00, 0x00, 0x00, 0x00, 0x00, 0x00, 0x00, 0x00, 0x00, 0x00, 0x00, 0x00, 0x00, 0x00, 0x00
};
// 'frame_7_delay-0', 128x64px
const unsigned char My_bitmapframe_7_delay_0[] PROGMEM = {
	0x00, 0x00, 0x00, 0x00, 0x00, 0x00, 0x00, 0x00, 0x00, 0x00, 0x00, 0x00, 0x00, 0x00, 0x00, 0x00, 
	0x00, 0x00, 0x00, 0x00, 0x00, 0x00, 0x00, 0x00, 0x00, 0x00, 0x00, 0x00, 0x00, 0x00, 0x00, 0x00, 
	0x00, 0x00, 0x00, 0x00, 0x00, 0x00, 0x00, 0x00, 0x00, 0x00, 0x00, 0x00, 0x00, 0x00, 0x00, 0x00, 
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	0x00, 0x00, 0x00, 0x00, 0x00, 0x00, 0x00, 0x00, 0x00, 0x00, 0x00, 0x00, 0x00, 0x00, 0x00, 0x00
};
// Array of all bitmaps for convenience. (Total bytes used to store images in PROGMEM = 8320)
const int My_bitmapallArray_LEN = 8;
const unsigned char* My_bitmapallArray[8] = {
  My_bitmapframe_0_delay_0,
	My_bitmapframe_1_delay_0,
	My_bitmapframe_2_delay_0,
	My_bitmapframe_3_delay_0,
	My_bitmapframe_4_delay_0,
	My_bitmapframe_5_delay_0,
	My_bitmapframe_6_delay_0,
	My_bitmapframe_7_delay_0
};

// 'LOGO 1', 128x64px
const unsigned char My_bitmapLOGO_1[] PROGMEM = {
	0x00, 0x00, 0x00, 0x00, 0x00, 0x00, 0x00, 0x00, 0x00, 0x00, 0x00, 0x00, 0x00, 0x00, 0x00, 0x00, 
	0x00, 0x00, 0x00, 0x00, 0x00, 0x00, 0x00, 0x00, 0x00, 0x00, 0x00, 0x00, 0x00, 0x00, 0x00, 0x00, 
	0x00, 0x00, 0x00, 0x00, 0x00, 0x00, 0x00, 0x00, 0x00, 0x00, 0x00, 0x00, 0x00, 0x00, 0x00, 0x00, 
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	0x00, 0x00, 0x00, 0x00, 0x00, 0x00, 0x00, 0x00, 0x00, 0x00, 0x00, 0x00, 0x00, 0x00, 0x00, 0x00
};

// 'SEARCHING', 128x64px
const unsigned char My_bitmapSEARCHING[] PROGMEM = {
	0x00, 0x00, 0x00, 0x00, 0x00, 0x00, 0x00, 0x00, 0x00, 0x00, 0x00, 0x00, 0x00, 0x00, 0x00, 0x00, 
	0x00, 0x00, 0x00, 0x00, 0x00, 0x00, 0x00, 0x00, 0x00, 0x00, 0x00, 0x00, 0x00, 0x00, 0x00, 0x00, 
	0x00, 0x00, 0x00, 0x00, 0x00, 0x00, 0x00, 0x00, 0x00, 0x00, 0x00, 0x00, 0x00, 0x00, 0x00, 0x00, 
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	0x00, 0x00, 0x00, 0x00, 0x00, 0x00, 0x00, 0x00, 0x00, 0x00, 0x00, 0x00, 0x00, 0x00, 0x00, 0x00
};
// Array of all bitmaps for convenience. (Total bytes used to store images in PROGMEM = 2080)
const int My_bitmapallArrayLS_LEN = 2;
const unsigned char* My_bitmapallArrayLS[2] = {
  My_bitmapLOGO_1,
	My_bitmapSEARCHING
};




// Struct to hold network information
struct WiFiNetwork {
  String SSID;         // Network name (SSID)
  int RSSI;            // Signal strength (RSSI)
  int encryptionType;  // Encryption type
  int channel;         // Channel number
  String macAddress;   // MAC Address of the network
};

// Create a vector to store all Wi-Fi networks found
std::vector<WiFiNetwork> networks;
std::set<String> ssidSet;  // Set to track SSIDs (prevents duplicates)

unsigned long lastDisplayUpdateMillis = 0;  // Time tracker for display update
const long displayUpdateInterval = 1000;    // Update every 1 second for progress bar (****)
unsigned long lastNetworkChangeMillis = 0;  // Time tracker for network change interval
size_t currentNetworkIndex = 0;             // To keep track of the current network to display
int progress = 0;                           // Progress for the progress bar
int progressMax = 5;                        // Max progress (5 steps for 5 seconds)
bool isScanning = false;                    // Flag to indicate if Wi-Fi scan is in progress



void setup() {
  // Start the Serial Monitor for debugging
  Serial.begin(115200);
  delay(5000); // Give time for Serial Monitor to initialize
  Serial.println("Wi-Fi Scanner Initialized.");

  // Start the display
  display.begin();
  
  // Clear the buffer (reset the display content)
  display.clearBuffer();
  for (int j = 0; j < 4; j++){
    for (int i = 0; i < My_bitmapallArray_LEN; i++) {
      // Clear the display to prepare for the next frame
      display.clearBuffer();

      // Display the current frame from the array
      display.drawXBMP(0, 0, 128, 64, My_bitmapallArray[i]);

      // Render the content to the screen
      display.sendBuffer();

      // Print a message to the Serial Monitor for debugging
      Serial.print("Displaying frame ");
      Serial.println(i);

      // Add a delay to control the frame rate
      delay(100); // the animation is run at 10 images per second
    }
  }
  // Display Wi-Fi logo and text
  display.clearBuffer();  // Clear the display buffer before displaying the image

  // Display the Wi-Fi logo from the bitmap array
  display.drawXBMP(0, 0, 128, 64, My_bitmapLOGO_1);  // Draw the bitmap at (0, 0) with 128x64 size
  
  display.sendBuffer();  // Render the content to the screen
  delay(3000); // Display the logo for 3 seconds
  
  // Clear the buffer (reset the display content)
  display.clearBuffer();
  
  // Display searching from the bitmap array
  display.drawXBMP(0, 0, 128, 64, My_bitmapSEARCHING);  // Draw the bitmap at (0, 0) with 128x64 size
  
  display.sendBuffer();  // Render the content to the screen
  
  // Start Wi-Fi
  WiFi.mode(WIFI_STA); 
  WiFi.disconnect(); 
  delay(3000);

  // Perform Wi-Fi scan on setup
  performWiFiScan();
}

void loop() {
  unsigned long currentMillis = millis();  // Get the current time in milliseconds

  // Check if it's time to perform a new Wi-Fi scan (after displaying the last network)
  if (currentMillis - lastDisplayUpdateMillis >= displayUpdateInterval && !isScanning) {
    lastDisplayUpdateMillis = currentMillis;  // Update the last display time

    // Display network information if networks are available
    if (networks.size() > 0) {
      WiFiNetwork network = networks[currentNetworkIndex];

      // Clear the display buffer for new content
      display.clearBuffer();
      display.setFont(u8g2_font_ncenB08_tr); // Set font to a smaller size

      // Check if the network is open (no encryption)
      if (network.encryptionType == WIFI_AUTH_OPEN) {
        display.setDrawColor(0); // Black on white
        display.drawBox(0, 0, 128, 64); // Invert background
        display.setDrawColor(1); // White text
      } else {
        display.setDrawColor(1); // Normal black text
      }

      // Display network number
      display.setCursor(0, 10);
      display.print("Net ");
      display.print(currentNetworkIndex + 1); // Display network index (1-based)
      display.print(" of ");
      display.println(networks.size());  // Total number of networks

      // Display SSID
      display.setCursor(0, 20);
      display.print("SSID: ");
      display.println(network.SSID);

      // Display Signal Strength
      display.setCursor(0, 30);
      display.print("Signal: ");
      display.print(network.RSSI);
      display.println(" dBm");

      // Display Encryption Type
      display.setCursor(0, 40);
      display.print("Enc: ");
      display.println(encryptionTypeToString(network.encryptionType));

      // Display Channel
      display.setCursor(0, 50);
      display.print("Chan: ");
      display.println(network.channel);

      // Display MAC Address
      display.setCursor(0, 60);
      display.print("MAC:");
      display.println(network.macAddress);

      // Display progress bar at the top-right (updated every second)
      display.setCursor(115,10);
      display.print("]");
      display.setCursor(80, 10);
      display.print("[*");
      int numBars = progress;  // Progress bar is filled based on the progress value
      for (int i = 0; i < numBars; i++) {
        display.print("*");  // Draw the filled part of the progress bar
      }
      display.sendBuffer();
    } else {
      // If no networks found, display a message
      display.clearBuffer();
      display.setFont(u8g2_font_ncenB08_tr); // Set font to a smaller size
      display.setCursor(0, 30);
      display.print("No Networks");
      display.sendBuffer();
    }

    // Update the progress
    progress++;

    // If the progress reaches the maximum (5 seconds), move to the next network
    if (progress >= progressMax) {
      progress = 0;  // Reset the progress bar
      currentNetworkIndex++; // Move to the next network

      // If we've reached the end of the list, start a new scan
      if (currentNetworkIndex >= networks.size()) {
        performWiFiScan();  // Trigger a new scan
      }
    }
  }
}


void performWiFiScan() {
  isScanning = true;  // Indicate that scanning is in progress
  display.clearBuffer();
  display.drawXBMP(0, 0, 128, 64, My_bitmapSEARCHING);
  display.sendBuffer();  
  Serial.println("Starting Wi-Fi scan...");

  std::set<String> newSsidSet;
  std::vector<WiFiNetwork> newNetworks;

  // Define country settings for EU only
  wifi_country_t region = {"EU", 1, 13}; // EU (Channels 1-13, including 5GHz availability)

  int scanTime = 30000;  // 30 seconds per scan

  esp_wifi_set_country(&region);
  Serial.print("Scanning in region: ");
  Serial.println(region.cc);

  int totalNetworks = WiFi.scanNetworks(false, true, 0, scanTime);

  if (totalNetworks > 0) {
    Serial.print(totalNetworks);
    Serial.println(" networks found:");

    for (int i = 0; i < totalNetworks; i++) {
      WiFiNetwork network;
      network.SSID = WiFi.SSID(i);
      network.RSSI = WiFi.RSSI(i);
      network.encryptionType = WiFi.encryptionType(i);
      network.channel = WiFi.channel(i);
      network.macAddress = WiFi.BSSIDstr(i);

      if (ssidSet.find(network.SSID) == ssidSet.end()) {
        newNetworks.push_back(network);
        newSsidSet.insert(network.SSID);
        ssidSet.insert(network.SSID);
      }
    }
  } else {
    Serial.println("No networks found in this region.");
  }

  if (!newNetworks.empty()) {
    networks.insert(networks.end(), newNetworks.begin(), newNetworks.end());
  }

  if (newNetworks.empty()) {
    currentNetworkIndex = 0;
  } else {
    if (currentNetworkIndex >= networks.size()) {
      currentNetworkIndex = networks.size() - 1;
    }
  }

  isScanning = false;
}


// Helper function to convert encryption type to string
String encryptionTypeToString(int encryptionType) {
  switch (encryptionType) {
    case WIFI_AUTH_OPEN:
      return "Open";
    case WIFI_AUTH_WEP:
      return "WEP";
    case WIFI_AUTH_WPA_PSK:
      return "WPA-PSK";
    case WIFI_AUTH_WPA2_PSK:
      return "WPA2-PSK";
    case WIFI_AUTH_WPA_WPA2_PSK:
      return "WPA/WPA2-PSK";
    case WIFI_AUTH_WPA3_PSK:
      return "WPA3-PSK";
    case WIFI_AUTH_WPA2_ENTERPRISE:
      return "WPA2-Enterprise";
    case WIFI_AUTH_OWE:
      return "OWE";
    default:
      return "Unknown";
  }
}
